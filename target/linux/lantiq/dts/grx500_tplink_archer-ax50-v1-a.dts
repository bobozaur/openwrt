// SPDX-License-Identifier: GPL-2.0-only
/dts-v1/;
#include "grx500_tplink_archer-ax50-v1.dtsi"

/ {
	chosen {
		bootargs = "console=ttyLTQ0,115200 earlycon panic=5 ubi.mtd=system_sw,2048 ubi.block=0,rootfsA root=/dev/ubiblock0_1 rootfstype=squashfs ro fstools_overlay_name=ax50_overlayA ubifs.default_version=4 thread_backlog_napi";
	};
};
