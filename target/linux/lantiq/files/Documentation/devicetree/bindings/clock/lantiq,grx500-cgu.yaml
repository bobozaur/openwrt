## target/linux/lantiq/files/Documentation/devicetree/bindings/clock/lantiq,grx500-cgu.yaml
```yaml
# SPDX-License-Identifier: (GPL-2.0-only OR BSD-2-Clause)
%YAML 1.2
---
$id: http://devicetree.org/schemas/clock/lantiq,grx500-cgu.yaml#
$schema: http://devicetree.org/meta-schemas/core.yaml#

title: Lantiq GRX500 clock generation unit

maintainers:
  - OpenWrt Development List <openwrt-devel@lists.openwrt.org>

description: |
  CPU and FPI clocks, USB and PCIe gates, and the shared PCIe reference PLL.
  Clock indices are defined in dt-bindings/clock/lantiq,grx500-cgu.h.

properties:
  compatible:
    items:
      - const: lantiq,grx500-cgu
      - const: syscon
  reg:
    maxItems: 1
  native-endian: true
  '#clock-cells':
    const: 1

required:
  - compatible
  - reg
  - native-endian
  - '#clock-cells'

additionalProperties: false
```

## target/linux/lantiq/files/Documentation/devicetree/bindings/gpio/lantiq,grx500-gpio.yaml
```yaml
# SPDX-License-Identifier: (GPL-2.0-only OR BSD-2-Clause)
%YAML 1.2
---
$id: http://devicetree.org/schemas/gpio/lantiq,grx500-gpio.yaml#
$schema: http://devicetree.org/meta-schemas/core.yaml#

title: Lantiq GRX500 GPIO bank

maintainers:
  - OpenWrt Development List <openwrt-devel@lists.openwrt.org>

description: |
  Each bank has 32 GPIO lines and a separate pad configuration window.
  The GPIO specifier contains the bank-local pin number and standard flags,
  including polarity, drive type and pull configuration.

properties:
  compatible:
    const: lantiq,grx500-gpio
  reg:
    items:
      - description: GPIO data, direction and atomic set/clear registers
      - description: Per-pin mux, drive and pull configuration
  reg-names:
    items:
      - const: gpio
      - const: pad
  gpio-controller: true
  '#gpio-cells':
    const: 2
  gpio-line-names:
    maxItems: 32
  lantiq,rcu:
    $ref: /schemas/types.yaml#/definitions/phandle
    description: Shared reset-controller syscon containing the interface mux
  lantiq,bbspi-en:
    $ref: /schemas/types.yaml#/definitions/uint32
    enum: [0, 1]
    description: |
      Board selection of the top-level BBSPI pad routing, specified on GPIO
      bank 1. Zero disables BBSPI and one enables it. The setting is applied
      before GPIO consumers can request pins. If absent, retain the firmware
      routing configuration.

required:
  - compatible
  - reg
  - reg-names
  - gpio-controller
  - '#gpio-cells'

dependencies:
  lantiq,bbspi-en:
    - lantiq,rcu

additionalProperties: false
```

## target/linux/lantiq/files/Documentation/devicetree/bindings/mips/lantiq/lantiq,grx500.yaml
```yaml
# SPDX-License-Identifier: (GPL-2.0-only OR BSD-2-Clause)
%YAML 1.2
---
$id: http://devicetree.org/schemas/mips/lantiq/lantiq,grx500.yaml#
$schema: http://devicetree.org/meta-schemas/core.yaml#

title: Lantiq GRX500 boards

maintainers:
  - OpenWrt Development List <openwrt-devel@lists.openwrt.org>

properties:
  compatible:
    items:
      - const: tplink,archer-ax50-v1
      - const: lantiq,grx500

additionalProperties: true
```

## target/linux/lantiq/files/Documentation/devicetree/bindings/mtd/lantiq,grx500-nand.yaml
```yaml
# SPDX-License-Identifier: (GPL-2.0-only OR BSD-2-Clause)
%YAML 1.2
---
$id: http://devicetree.org/schemas/mtd/lantiq,grx500-nand.yaml#
$schema: http://devicetree.org/meta-schemas/core.yaml#

title: Lantiq GRX500 EBU NAND interface

maintainers:
  - OpenWrt Development List <openwrt-devel@lists.openwrt.org>

description: |
  A single NAND chip shares this node with its EBU controller. The NAND access
  window includes the command/address latch aliases; the second window holds
  the EBU timing and ready/busy registers. Supported flash geometry is 2048-byte
  pages, 64-byte OOB and 128-KiB eraseblocks, with software BCH4 per 512 bytes.
  Fixed partitions describe bootloader and per-device data as well as UBI.

allOf:
  - $ref: nand-chip.yaml#

properties:
  compatible:
    const: lantiq,grx500-nand
  reg:
    items:
      - description: NAND data and command/address latch window
      - description: EBU configuration registers
  reg-names:
    items:
      - const: nand
      - const: ebu
  nand-bus-width:
    $ref: /schemas/types.yaml#/definitions/uint32
    const: 8
  nand-use-soft-ecc-engine: true
  nand-ecc-algo:
    const: bch
  nand-ecc-step-size:
    const: 512
  nand-ecc-strength:
    const: 4

required:
  - compatible
  - reg
  - reg-names
  - nand-bus-width
  - nand-use-soft-ecc-engine
  - nand-ecc-algo
  - nand-ecc-step-size
  - nand-ecc-strength

unevaluatedProperties: false
```

## target/linux/lantiq/files/Documentation/devicetree/bindings/net/dsa/lantiq,grx500-switch.yaml
```yaml
# SPDX-License-Identifier: (GPL-2.0-only OR BSD-2-Clause)
%YAML 1.2
---
$id: http://devicetree.org/schemas/net/dsa/lantiq,grx500-switch.yaml#
$schema: http://devicetree.org/meta-schemas/core.yaml#

title: Lantiq GRX500 LAN switch

maintainers:
  - OpenWrt Development List <openwrt-devel@lists.openwrt.org>

description: |
  Child of the GRX500 Ethernet controller, sharing its LAN switch MMIO region.
  Port 0 connects to the LAN DMA conduit; ports 2 through 5 connect to internal
  GPHYs. Port 1 is unused. VLAN-unaware bridges can forward learned unicast
  between user ports in hardware. Unknown, group and local traffic is sent to
  the CPU port. Linux owns VLAN filtering and bridge modes that require CPU
  forwarding; spanning-tree state controls the hardware forwarding domain.

allOf:
  - $ref: dsa.yaml#/$defs/ethernet-ports

properties:
  compatible:
    const: lantiq,grx500-switch
  ports:
    type: object
    patternProperties:
      '^port@[0-9a-f]+$':
        type: object
        properties:
          reg:
            enum: [0, 2, 3, 4, 5]

required:
  - compatible
  - ports

unevaluatedProperties: false
```

## target/linux/lantiq/files/Documentation/devicetree/bindings/net/lantiq,grx500-ethernet.yaml
```yaml
# SPDX-License-Identifier: (GPL-2.0-only OR BSD-2-Clause)
%YAML 1.2
---
$id: http://devicetree.org/schemas/net/lantiq,grx500-ethernet.yaml#
$schema: http://devicetree.org/meta-schemas/core.yaml#

title: Lantiq GRX500 Ethernet DMA and switch integration

maintainers:
  - OpenWrt Development List <openwrt-devel@lists.openwrt.org>

description: |
  Owns the LAN and WAN switch register windows, two DMA pairs and five GPHYs.
  The LAN Ethernet child is the DSA CPU conduit; the WAN child is an ordinary
  Ethernet interface. Each child owns its MDIO bus. The switch child shares
  its parent's LAN switch resource. The driver loads the 64-KiB executable
  GPHY body through the firmware loader; OEM containers are decoded by userspace.

properties:
  compatible:
    const: lantiq,grx500-ethernet
  reg:
    minItems: 6
    maxItems: 6
  reg-names:
    items:
      - const: switch
      - const: rx-dma
      - const: tx-dma
      - const: wan-switch
      - const: wan-rx-dma
      - const: wan-tx-dma
  interrupts:
    maxItems: 4
  interrupt-names:
    items:
      - const: rx
      - const: tx
      - const: wan-rx
      - const: wan-tx
  resets:
    description: LAN GPHYs 0 through 3, then the WAN GPHY
    minItems: 5
    maxItems: 5

  "#address-cells":
    const: 1
  "#size-cells":
    const: 0

  ethernet@0:
    type: object
    properties:
      reg:
        const: 0
      mdio:
        $ref: mdio.yaml#
        unevaluatedProperties: false
    required:
      - reg
      - mdio
    additionalProperties: false

  ethernet@1:
    $ref: ethernet-controller.yaml#
    properties:
      reg:
        const: 1
      label: true
      mdio:
        $ref: mdio.yaml#
        unevaluatedProperties: false
    required:
      - reg
      - phy-mode
      - phy-handle
      - mdio
    unevaluatedProperties: false

  switch:
    $ref: dsa/lantiq,grx500-switch.yaml#

required:
  - compatible
  - reg
  - reg-names
  - interrupts
  - interrupt-names
  - resets
  - "#address-cells"
  - "#size-cells"
  - ethernet@0
  - ethernet@1
  - switch

additionalProperties: false
```

## target/linux/lantiq/files/Documentation/devicetree/bindings/pci/lantiq,grx500-pcie.yaml
```yaml
# SPDX-License-Identifier: (GPL-2.0-only OR BSD-2-Clause)
%YAML 1.2
---
$id: http://devicetree.org/schemas/pci/lantiq,grx500-pcie.yaml#
$schema: http://devicetree.org/meta-schemas/core.yaml#

title: Lantiq GRX500 paired PCIe controllers

maintainers:
  - OpenWrt Development List <openwrt-devel@lists.openwrt.org>

description: |
  The two root complexes share a reference PLL and endpoint startup sequence.
  Both controllers must be configured before either endpoint leaves reset.
  This node describes the paired controller owner, not a PCI bus. It creates
  two PCI domains using the fixed SoC outbound apertures. The main controller
  supplies the shared endpoint INTA interrupt; the auxiliary function is used
  for configuration and initialization.

properties:
  compatible:
    const: lantiq,grx500-pcie
  reg:
    minItems: 8
    maxItems: 8
  reg-names:
    items:
      - const: csr0
      - const: config0
      - const: app0
      - const: phy0
      - const: csr1
      - const: config1
      - const: app1
      - const: phy1
  interrupts:
    maxItems: 1
  clocks:
    maxItems: 3
  clock-names:
    items:
      - const: pcie0
      - const: pcie1
      - const: pll
  resets:
    minItems: 2
    maxItems: 2
  main-reset-gpios:
    description: Main endpoint PERST line
    maxItems: 1
  aux-reset-gpios:
    description: Auxiliary endpoint PERST line
    maxItems: 1
  lantiq,rcu:
    $ref: /schemas/types.yaml#/definitions/phandle
    description: Reset and endian configuration syscon

required:
  - compatible
  - reg
  - reg-names
  - interrupts
  - clocks
  - clock-names
  - resets
  - main-reset-gpios
  - aux-reset-gpios
  - lantiq,rcu

additionalProperties: false
```

## target/linux/lantiq/files/Documentation/devicetree/bindings/reset/lantiq,grx500-rcu.yaml
```yaml
# SPDX-License-Identifier: (GPL-2.0-only OR BSD-2-Clause)
%YAML 1.2
---
$id: http://devicetree.org/schemas/reset/lantiq,grx500-rcu.yaml#
$schema: http://devicetree.org/meta-schemas/core.yaml#

title: Lantiq GRX500 reset and system configuration unit

maintainers:
  - OpenWrt Development List <openwrt-devel@lists.openwrt.org>

description: |
  Reset IDs 0 through 31 select bits in the request register at offset 0x10;
  IDs 32 through 63 select bits in the request register at offset 0x48.
  The region also contains peripheral endian and PHY configuration registers.

properties:
  compatible:
    items:
      - const: lantiq,grx500-rcu
      - const: syscon
  reg:
    maxItems: 1
  native-endian: true
  '#reset-cells':
    const: 1

required:
  - compatible
  - reg
  - native-endian
  - '#reset-cells'

additionalProperties: false
```

## target/linux/lantiq/files/Documentation/devicetree/bindings/usb/lantiq,grx500-dwc3.yaml
```yaml
# SPDX-License-Identifier: (GPL-2.0-only OR BSD-2-Clause)
%YAML 1.2
---
$id: http://devicetree.org/schemas/usb/lantiq,grx500-dwc3.yaml#
$schema: http://devicetree.org/meta-schemas/core.yaml#

title: Lantiq GRX500 DWC3 integration

maintainers:
  - OpenWrt Development List <openwrt-devel@lists.openwrt.org>

description: |
  The wrapper sequences the clock, reset, PHY and VBUS before populating its
  DWC3 child. Parent and child describe the same register aperture; only the
  child owns the live core resource. The wrapper accesses it during startup
  before registering the child and removes the child before powering down.

properties:
  compatible:
    const: lantiq,grx500-dwc3
  reg:
    maxItems: 1
  reg-names:
    const: core
  clocks:
    maxItems: 1
  resets:
    maxItems: 1
  vbus-gpios:
    description: External VBUS power switch
    maxItems: 1
  lantiq,port:
    $ref: /schemas/types.yaml#/definitions/uint32
    enum: [0, 1]
    description: SoC USB controller index
  lantiq,rcu:
    $ref: /schemas/types.yaml#/definitions/phandle
    description: Reset and endian configuration syscon
  '#address-cells':
    const: 1
  '#size-cells':
    const: 1
  ranges: true
  dma-ranges:
    maxItems: 1

patternProperties:
  '^usb@[0-9a-f]+$':
    $ref: snps,dwc3.yaml#
    unevaluatedProperties: false

required:
  - compatible
  - reg
  - reg-names
  - clocks
  - resets
  - vbus-gpios
  - lantiq,port
  - lantiq,rcu
  - '#address-cells'
  - '#size-cells'
  - ranges
  - dma-ranges

additionalProperties: false
```
