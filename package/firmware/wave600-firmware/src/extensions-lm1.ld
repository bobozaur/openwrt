/* SPDX-License-Identifier: GPL-2.0-only */
native_bank_begin = 0x130000;
native_bank_end = 0x180000;
native_unused_begin = 0x175350;
native_user_init = 0x15ca58;
native_unused_publication = 0x1304cc;
extension_code_begin = 0x176000;
extension_state_begin = 0x17c000;
extension_reserved_end = 0x17e000;
INCLUDE extensions.ld
