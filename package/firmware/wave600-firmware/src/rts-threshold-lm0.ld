/* SPDX-License-Identifier: GPL-2.0-only */
/* Independently matched native A0 lower0 owners. */
native_fixed_entry = 0x101688;
native_message_send = 0xf1378;
native_vap_first = 0xe44b8;
native_vap_count = 0xe44d4;
native_vap_states = 0x113ef8;
native_sta_states = 0x113f18;
rts_dispatch_site = 0x10eab8;
rts_completion_site = 0x101572;
rts_vap_site = 0xec57e;
rts_sta_site = 0x103614;
rts_group_site = 0x1035ec;
rts_group_constructor_site = 0xffe00;
INCLUDE extensions-lm0.ld
INCLUDE rts-threshold.ld
