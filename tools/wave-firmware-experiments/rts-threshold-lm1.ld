/* SPDX-License-Identifier: GPL-2.0-only */
/* Independently matched native A0 lower1 owners. */
native_fixed_entry = 0x151434;
native_message_send = 0x1410e4;
native_vap_first = 0x1344a4;
native_vap_count = 0x1344d8;
native_vap_states = 0x163b68;
native_sta_states = 0x163b88;
rts_dispatch_site = 0x15e72c;
rts_completion_site = 0x15131e;
rts_vap_site = 0x13c41e;
rts_sta_site = 0x1533a4;
rts_group_site = 0x15337c;
rts_group_constructor_site = 0x14fbac;
INCLUDE extensions-lm1.ld
INCLUDE rts-threshold.ld
